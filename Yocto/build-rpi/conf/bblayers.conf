## Yocto/build-rpi/conf/bblayers.conf
```bitbake
# POKY_BBLAYERS_CONF_VERSION is increased each time build/conf/bblayers.conf
# changes incompatibly
POKY_BBLAYERS_CONF_VERSION = "2"

BBPATH = "${TOPDIR}"
BBFILES ?= ""

BBLAYERS ?= " \
  /home/eve/Documentos/Yocto/poky-warrior/meta \
  /home/eve/Documentos/Yocto/poky-warrior/meta-poky \
  /home/eve/Documentos/Yocto/poky-warrior/meta-yocto-bsp \
  /home/eve/Documentos/Yocto/poky-warrior/meta-openembedded/meta-oe \
  /home/eve/Documentos/Yocto/poky-warrior/meta-openembedded/meta-networking \
  /home/eve/Documentos/Yocto/poky-warrior/meta-openembedded/meta-python \
  /home/eve/Documentos/Yocto/poky-warrior/meta-openembedded/meta-gnome\
  /home/eve/Documentos/Yocto/poky-warrior/meta-openembedded/meta-multimedia \
  /home/eve/Documentos/Yocto/poky-warrior/meta-raspberrypi \
  /home/eve/Documentos/Yocto/poky-warrior/meta-rpi-wifi \
  /home/eve/Documentos/Yocto/poky-warrior/meta-rpi-xfce \
  "
```

## Yocto/meta-rpi-xfce/conf/layer.conf
```bitbake
# We have a conf and classes directory, append to BBPATH
BBPATH .= ":${LAYERDIR}"

# We have a recipes directory, add to BBFILES
BBFILES += "${LAYERDIR}/recipes-*/*/*.bb ${LAYERDIR}/recipes-*/*/*.bbappend"

BBFILE_COLLECTIONS += "rpi-xfce"
BBFILE_PATTERN_rpi-xfce := "^${LAYERDIR}/"
BBFILE_PRIORITY_rpi-xfce- = "7"

# This should only be incremented on significant changes that will
# cause compatibility issues with other layers
LAYERVERSION_xfce-layer = "1"

LAYERDEPENDS_rpi-xfce = "core"
LAYERDEPENDS_rpi-xfce += "openembedded-layer"
LAYERDEPENDS_rpi-xfce += "gnome-layer"
LAYERDEPENDS_rpi-xfce += "multimedia-layer"
LAYERDEPENDS_rpi-xfce += "meta-python"
LAYERDEPENDS_rpi-xfce += "networking-layer"

LAYERSERIES_COMPAT_rpi-xfce = "warrior"

SIGGEN_EXCLUDE_SAFE_RECIPE_DEPS += " \
  xfce4-session->machine-host \
"
```
